## src/serprog/main/Kconfig.projbuild
```kconfig
menu "Read-only SPI NOR reader"
config READER_MAX_SPI_HZ
    int "SPI frequency ceiling (raise only after verified 500 kHz dumps)"
    range 500000 4000000
    default 500000
config ESP32_SERPROG_WIFI_DISABLED
    bool
    default y
endmenu
```

## src/serprog/sdkconfig.defaults
```kconfig
CONFIG_ESP32_SERPROG_WIFI_DISABLED=y
CONFIG_READER_MAX_SPI_HZ=500000
CONFIG_LOG_DEFAULT_LEVEL_NONE=y
CONFIG_BOOTLOADER_LOG_LEVEL_NONE=y
CONFIG_ESP_MAIN_TASK_STACK_SIZE=4096
```
